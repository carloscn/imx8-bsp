## bsp/configs/imx8_linux_arm64_noram.its
```
/*
 * Copyright 2024 Carlos
 *
 */


/dts-v1/;

/ {
	description = "arm64 kernel, ramdisk and FDT blob";
	#address-cells = <1>;

	images {
		kernel {
			description = "ARM64 Kernel";
			data = /incbin/("../linux-imx/arch/arm64/boot/Image.gz");
			type = "kernel";
			arch = "arm64";
			os = "linux";
			compression = "gzip";
			load = <0x40480000>;
			entry = <0x40480000>;
			hash {
				algo = "sha256";
			};
			signature {
				algo = "sha256,rsa2048";
				key-name-hint = "dev";
			};
		};

        imx8-dtb {
            description = "imx8-dtb";
            data = /incbin/("../linux-imx/arch/arm64/boot/dts/freescale/imx8mq-evk-root.dtb");
            type = "flat_dt";
            arch = "arm64";
            os = "linux";
            compression = "none";
            load = <0x43000000>;
            hash {
                algo = "sha256";
            };
            signature {
                algo = "sha256,rsa2048";
                key-name-hint = "dev";
            };
        };
	};

	configurations {
		default = "imx8";
		imx8 {
			description = "config for imx8-dtb";
			kernel = "kernel";
			fdt = "imx8-dtb";
			signature {
				algo = "sha256,rsa2048";
				key-name-hint = "dev";
				sign-images = "kernel", "fdt","ramdisk";
			};
		};
	};
};
```
